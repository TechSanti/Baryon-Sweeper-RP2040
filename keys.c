#include "keys.h"

#include <stddef.h>
#include <string.h>

#define ARRAY_COUNT(a) (sizeof(a) / sizeof((a)[0]))

#ifndef LEGACY_CHALLENGE_MAP
#define LEGACY_CHALLENGE_MAP 1
#endif

const byte answer_08[] = {0xA5, 0x04, 0x06, 0xE2, 0x04, 0x6A};
const byte answer_0D[] = {0xA5, 0x07, 0x06, 0x9D, 0x10, 0x10, 0x28, 0x14, 0x54};
const byte answer_16[] = {0xA5, 0x13, 0x06, 0x53, 0x6F, 0x6E, 0x79, 0x45, 0x6E, 0x65, 0x72, 0x67, 0x79, 0x44, 0x65, 0x76, 0x69, 0x63, 0x65, 0x73, 0x6B};
const byte answer_04[] = {0xA5, 0x04, 0x06, 0x68, 0x10, 0xD8};
const byte answer_02[] = {0xA5, 0x03, 0x06, 0x1B, 0x36};
const byte answer_09[] = {0xA5, 0x04, 0x06, 0x01, 0x04, 0x4B};
const byte answer_0B[] = {0xA5, 0x04, 0x06, 0x0F, 0x00, 0x41};
const byte answer_07[] = {0xA5, 0x04, 0x06, 0x08, 0x07, 0x41};
const byte answer_03[] = {0xA5, 0x04, 0x06, 0x36, 0x10, 0x0A};
const byte answer_01[] = {0xA5, 0x05, 0x06, 0x10, 0xC3, 0x06, 0x76};
const byte answer_90[] = {0xA5, 0x2A, 0x06, 0x20, 0x01, 0x00, 0x00, 0x82, 0x82, 0x82, 0x82};
const byte psp_81[] = {0x5A, 0x02, 0x01, 0xA2};

const byte go_key1[] = {0xC6, 0x6E, 0x9E, 0xD6, 0xEC, 0xBC, 0xB1, 0x21, 0xB7, 0x46, 0x5D, 0x25, 0x03, 0x7D, 0x66, 0x46};
const byte go_key2[] = {0xDA, 0x24, 0xDA, 0xB4, 0x3A, 0x61, 0xCB, 0xDF, 0x61, 0xFD, 0x25, 0x5D, 0x0A, 0xEA, 0x79, 0x57};
const byte go_secret[] = {0x88, 0x0E, 0x2A, 0x94, 0x11, 0x09, 0x26, 0xB2, 0x0E, 0x53, 0xE2, 0x2A, 0xE6, 0x48, 0xAE, 0x9D};

static const byte keystore_versions[] = {
    0x00, 0x01, 0x02, 0x03, 0x04, 0x05, 0x06, 0x08, 0x09,
    0x0A, 0x0B, 0x0C, 0x0D, 0x2F, 0x97, 0xB3, 0xD9, 0xEB
};

static const byte keystore[][16] = {
    {0x5C, 0x52, 0xD9, 0x1C, 0xF3, 0x82, 0xAC, 0xA4, 0x89, 0xD8, 0x81, 0x78, 0xEC, 0x16, 0x29, 0x7B},
    {0x9D, 0x4F, 0x50, 0xFC, 0xE1, 0xB6, 0x8E, 0x12, 0x09, 0x30, 0x7D, 0xDB, 0xA6, 0xA5, 0xB5, 0xAA},
    {0x09, 0x75, 0x98, 0x88, 0x64, 0xAC, 0xF7, 0x62, 0x1B, 0xC0, 0x90, 0x9D, 0xF0, 0xFC, 0xAB, 0xFF},
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    {0x41, 0x84, 0x99, 0xBE, 0x9D, 0x35, 0xA3, 0xB9, 0xFC, 0x6A, 0xD0, 0xD6, 0xF0, 0x41, 0xBB, 0x26}
};

/*
 * As tabelas de challenge não têm entradas para 0x09, 0x0B e 0x0C.
 * Por isso elas possuem seu próprio mapa, separado do mapa do keystore.
 */
static const byte challenge_versions[] = {
    0x00, 0x01, 0x02, 0x03, 0x04, 0x05, 0x06, 0x08,
    0x0A, 0x0D, 0x2F, 0x97, 0xB3, 0xD9, 0xEB
};

static const byte challenge1_secret[][8] = {
    {0xD2, 0x07, 0x22, 0x53, 0xA4, 0xF2, 0x74, 0x68},
    {0xB3, 0x7A, 0x16, 0xEF, 0x55, 0x7B, 0xD0, 0x89},
    {0xA0, 0x4E, 0x32, 0xBB, 0xA7, 0x13, 0x9E, 0x46},
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    {0x0B, 0xD9, 0x02, 0x7E, 0x85, 0x1F, 0xA1, 0x23}
};

static const byte challenge2_secret[][8] = {
    {0xF5, 0xD7, 0xD4, 0xB5, 0x75, 0xF0, 0x8E, 0x4E},
    {0xCC, 0x69, 0x95, 0x81, 0xFD, 0x89, 0x12, 0x6C},
    {0x49, 0x5E, 0x03, 0x47, 0x94, 0x93, 0x1D, 0x7B},
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    {0xF7, 0x91, 0xED, 0x0B, 0x3F, 0x49, 0xA4, 0x48}
};

_Static_assert(ARRAY_COUNT(keystore_versions) == ARRAY_COUNT(keystore),
               "Mapa de versões do keystore incompatível");
_Static_assert(ARRAY_COUNT(challenge_versions) == ARRAY_COUNT(challenge1_secret),
               "Mapa da challenge 1 incompatível");
_Static_assert(ARRAY_COUNT(challenge_versions) == ARRAY_COUNT(challenge2_secret),
               "Mapa da challenge 2 incompatível");

static bool copy_versioned_value(const byte *versions,
                                 size_t version_count,
                                 const byte *values,
                                 size_t value_size,
                                 byte version,
                                 byte *out) {
    if (versions == NULL || values == NULL || out == NULL || value_size == 0U) {
        return false;
    }

    for (size_t i = 0; i < version_count; ++i) {
        if (versions[i] == version) {
            memcpy(out, values + (i * value_size), value_size);
            return true;
        }
    }

    memset(out, 0, value_size);
    return false;
}

bool get_keystore(byte version, byte out_key[16]) {
    return copy_versioned_value(
        keystore_versions,
        ARRAY_COUNT(keystore_versions),
        &keystore[0][0],
        sizeof(keystore[0]),
        version,
        out_key
    );
}

#if LEGACY_CHALLENGE_MAP
static bool copy_legacy_challenge(const byte values[][8],
                                  size_t values_count,
                                  byte version,
                                  byte out_secret[8]) {
    if (values == NULL || out_secret == NULL) {
        return false;
    }

    /* Reproduz exatamente o índice usado pelo firmware original: o índice da
     * versão no keystore também seleciona o secret. Isso é mantido como modo
     * padrão de compatibilidade porque foi o comportamento testado no PSP. */
    for (size_t i = 0; i < ARRAY_COUNT(keystore_versions); ++i) {
        if (keystore_versions[i] == version) {
            if (i < values_count) {
                memcpy(out_secret, values[i], 8U);
            } else {
                memset(out_secret, 0, 8U);
            }
            return true;
        }
    }

    memset(out_secret, 0, 8U);
    return false;
}
#endif

bool get_challenge1_secret(byte version, byte out_secret[8]) {
#if LEGACY_CHALLENGE_MAP
    return copy_legacy_challenge(
        challenge1_secret,
        ARRAY_COUNT(challenge1_secret),
        version,
        out_secret
    );
#else
    return copy_versioned_value(
        challenge_versions,
        ARRAY_COUNT(challenge_versions),
        &challenge1_secret[0][0],
        sizeof(challenge1_secret[0]),
        version,
        out_secret
    );
#endif
}

bool get_challenge2_secret(byte version, byte out_secret[8]) {
#if LEGACY_CHALLENGE_MAP
    return copy_legacy_challenge(
        challenge2_secret,
        ARRAY_COUNT(challenge2_secret),
        version,
        out_secret
    );
#else
    return copy_versioned_value(
        challenge_versions,
        ARRAY_COUNT(challenge_versions),
        &challenge2_secret[0][0],
        sizeof(challenge2_secret[0]),
        version,
        out_secret
    );
#endif
}
